#include <Mouse.h>
#include <Keyboard.h>
#include <Adafruit_CircuitPlayground.h>
#include <Wire.h>
#include <SPI.h>

const uint8_t spZERO[] PROGMEM = {0x69,0xFB,0x59,0xDD,0x51,0xD5,0xD7,0xB5,0x6F,0x0A,0x78,0xC0,0x52,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0xFF,0x1F};
const uint8_t spONE[] PROGMEM = {0x66,0x4E,0xA8,0x7A,0x8D,0xED,0xC4,0xB5,0xCD,0x89,0xD4,0xBC,0xA2,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0xFE,0x1F};
const uint8_t spTWO[]  PROGMEM = {0x06,0xB8,0x59,0x34,0x00,0x27,0xD6,0x38,0x60,0x58,0xD3,0x91,0x55,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0xFF,0x1F};
const uint8_t spTHREE[]             PROGMEM ={0x0C,0x08,0xCA,0x44,0x02,0x1A,0xB0,0x40,0xC8,0x4D,0x15,0x73,0xCB,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0xCC,0x03};
const uint8_t spREADY_TO_START[]    PROGMEM ={0xAE,0x91,0x85,0xD3,0x32,0xB8,0xB5,0xC6,0x35,0x4E,0x09,0xCA,0x7E,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0x00,0x00};
const uint8_t spTHE[]               PROGMEM ={0xA1,0xB5,0x86,0xD3,0xD8,0x1B,0xB9,0xD6,0x1A,0x0E,0x61,0x5F,0x18,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0x00,0x00};
const uint8_t spPROGRAM[]           PROGMEM ={0x0A,0x30,0x3E,0x55,0x00,0xAE,0x43,0xB8,0x3C,0xB5,0x54,0x77,0x95,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0xAE,0x1F};
const uint8_t spNOW[]               PROGMEM ={0xA9,0x4D,0x9A,0xCD,0x9C,0xDB,0xD6,0xF6,0xD4,0xC9,0x77,0xAA,0x79,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0x00,0x00};
const uint8_t spPAUSE[]    PROGMEM = {0x00,0x00,0x00,0x00,0xFF,0x0F};

bool leftButtonPressed;
bool rightButtonPressed;

void setup() {
  Serial.begin(9600);
  Mouse.begin();
  Mouse.release(MOUSE_LEFT);
  Keyboard.begin();
  CircuitPlayground.begin();
  CircuitPlayground.clearPixels();
  pinMode(3, INPUT);

}

//Uploading the Code!: ppppp

void loop() {

  leftButtonPressed = CircuitPlayground.leftButton();
  rightButtonPressed = CircuitPlayground.rightButton();

  if (leftButtonPressed || rightButtonPressed) {
    
    //Serial.print("Button pressed, starting automation!");
    /*CircuitPlayground.speaker.say(spTHREE);
    CircuitPlayground.speaker.say(spPAUSE);
    CircuitPlayground.speaker.say(spTWO);
    CircuitPlayground.speaker.say(spPAUSE);
    CircuitPlayground.speaker.say(spONE);
    CircuitPlayground.speaker.say(spPAUSE);
    CircuitPlayground.speaker.say(spPAUSE);
    CircuitPlayground.speaker.say(spREADY_TO_START);
    CircuitPlayground.speaker.end();*/

    /*delay(500);
    Keyboard.write('p');
    delay(900);
    Keyboard.write('p');
    delay(1500);
    Keyboard.print("12");
    delay(700);
    Keyboard.print("34");
    delay(1000);*/

    delay(3000);
    Keyboard.write('p');
    delay(100);
    Keyboard.write('p');
    delay(1000);
    Keyboard.print("1234");
    delay(1000);


    for (int i = 0; i < 20; i++) {
      Mouse.move(-40, -40, 0);
    }
    delay(100);
    for (int i = 0; i < 5; i++) {
      Mouse.move(30, 15, 0);
    }
    delay(200);
    Mouse.press(MOUSE_LEFT);
    for (int i = 0; i < 5; i++) {
      Mouse.move(0, 10, 0);
    }
      Mouse.release(MOUSE_LEFT);
      delay(1000);
      Keyboard.press(KEY_BACKSPACE);
      Keyboard.release(KEY_BACKSPACE);
      delay(500);
      Keyboard.print("Phone");
      delay(100);
      Keyboard.press(KEY_RETURN);
      Keyboard.release(KEY_RETURN);

    delay(300);
  
    for (int i = 0; i < 20; i++) {
      Mouse.move(-40, 40, 0);
    }
    
    delay(300);
    Mouse.move(20, -23, 0);
    delay(400);
    Mouse.click();
    delay(500);
  
    for (int i = 0; i < 20; i++) {
      Mouse.move(40, -40, 0);
    }
    
    delay(600);
    Mouse.move(-20, 31, 0);
    Mouse.move(-20, 35, 0);
    Mouse.move(-20, 30, 0);
    delay(500);
  
    Mouse.press(MOUSE_LEFT);
    delay(600);
    Mouse.release(MOUSE_LEFT);
    delay(200);
    
    Mouse.move(-40, 45, 0);
    delay(500);
    Mouse.click();
    delay(600);
    Keyboard.press(KEY_LEFT_SHIFT);
    delay(100);
    Keyboard.release(KEY_LEFT_SHIFT );
    delay(300);
    Keyboard.press(KEY_BACKSPACE);
    delay(5000);
    Keyboard.release(KEY_BACKSPACE);
    delay(300);
    Keyboard.print("Help! I'm in anaphylactic shock. I'm in need of emergency medical assistance.");
    delay(1000);
    Keyboard.press(KEY_RETURN);
    Keyboard.release(KEY_RETURN);
    delay(450);
    Keyboard.print("Here is my current location:");
    delay(450);
    Keyboard.press(KEY_RETURN);
    Keyboard.release(KEY_RETURN);
  
    for (int i = 0; i < 20; i++) {
    Mouse.move(40, -40, 0);
    }
      
    delay(1000);
  
    Mouse.move(-70, 25, 0);
    Mouse.move(-35, 30, 0);
    delay(700);
    Mouse.click();
    delay(700);
    Mouse.move(0, 90, 0);
    Mouse.move(0, 67, 0);
    delay(500);
    Mouse.click();
  }
  
}
